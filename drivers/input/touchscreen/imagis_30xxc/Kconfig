## drivers/input/touchscreen/imagis_30xxc/Kconfig
```kconfig
#
# Imagis IST30XXC Touchscreen driver
#

config TOUCHSCREEN_IST30XXC
  tristate "IST30XXC I2C Touchscreen"
	depends on I2C
	help
	  Say Y here if you have the Imagis IST30XXC I2C touchscreen
	  connected to your system.

config TOUCHSCREEN_IST30XXC_WAKE_GESTURE
        bool "Wake gestures interface for Imagis IST30XXC I2C touchscreen"
        depends on TOUCHSCREEN_MMS300_A
        default y
```
